## dts/bindings/sensirion,sts40.yaml
```yaml
# Copyright (c) 2025
# SPDX-License-Identifier: Apache-2.0

description: Sensirion STS40 Digital Temperature Sensor

compatible: "sensirion,sts40"

include: [sensor-device.yaml, i2c-device.yaml]

properties:
  precision:
    type: string
    default: "high"
    enum:
      - "high"
      - "medium" 
      - "low"
    description: |
      Measurement precision level:
      - high: Highest accuracy, longest measurement time (~10ms)
      - medium: Medium accuracy, medium measurement time (~10ms)  
      - low: Lowest accuracy, shortest measurement time (~10ms)

  reg:
    required: true
    description: |
      I2C address of the sensor. The STS40 supports three different addresses:
      - 0x46 (primary/default address)
      - 0x44 (alternative address 1)
      - 0x45 (alternative address 2)
```

## sensor/sts40/Kconfig
```kconfig
# Copyright (c) 2025
# SPDX-License-Identifier: Apache-2.0

config STS40
	bool "STS40 Temperature Sensor"
	default n
	depends on DT_HAS_SENSIRION_STS40_ENABLED
	depends on I2C
	help
	  Enable driver for Sensirion STS40 digital temperature sensor.
	  The STS40 is a digital temperature sensor with I2C interface.
	  It provides high accuracy temperature measurements with different
	  precision levels (high, medium, low).

if STS40

config STS40_USE_SENSIRION_LIB
	bool "Use original Sensirion library implementation"
	default n
	help
	  Use the original Sensirion embedded-i2c-sts4x library implementation
	  instead of the native Zephyr driver. This provides compatibility with
	  existing Sensirion code but requires additional source files.

choice STS40_PRECISION
	prompt "Default measurement precision"
	default STS40_PRECISION_HIGH
	help
	  Select the default measurement precision for STS40 sensor.
	  Higher precision provides more accurate results but takes longer
	  to complete the measurement.

config STS40_PRECISION_HIGH
	bool "High precision"
	help
	  Use high precision mode (longest measurement time, highest accuracy).

config STS40_PRECISION_MEDIUM
	bool "Medium precision"
	help
	  Use medium precision mode (medium measurement time and accuracy).

config STS40_PRECISION_LOW
	bool "Low precision"
	help
	  Use low precision mode (shortest measurement time, lowest accuracy).

endchoice

endif # STS40
```
